// dacty_left.overlay

#include "dactyl.dtsi" // Notice that the main dtsi files are included in the overlay.

&kscan {
    col-gpios
        = <&gpio1 9 GPIO_ACTIVE_HIGH> // col1 in the schematic
        , <&gpio0 8 GPIO_ACTIVE_HIGH> // col2 in the schematic
        , <&gpio0 6 GPIO_ACTIVE_HIGH> // col3 in the schematic
        , <&gpio0 27 GPIO_ACTIVE_HIGH> // col4 in the schematic
        , <&gpio0 26 GPIO_ACTIVE_HIGH> // col5 in the schematic
        , <&gpio0 7 GPIO_ACTIVE_HIGH> // col6 in the schematic
        ;
};